## CMakeLists.txt
```
# SPDX-License-Identifier: Apache-2.0

cmake_minimum_required(VERSION 3.13.1)

find_package(Zephyr REQUIRED HINTS $ENV{ZEPHYR_BASE})
project(intel-ecfw-zephyr-dummy)

target_sources(app PRIVATE src/main.c)
```

## prj.conf
```kconfig
# copied from interl-ecfw

#
# General Kernel Options
#

CONFIG_MULTITHREADING=y
CONFIG_NUM_COOP_PRIORITIES=16
CONFIG_NUM_PREEMPT_PRIORITIES=15
CONFIG_MAIN_THREAD_PRIORITY=0
CONFIG_PRIORITY_CEILING=-127
CONFIG_NUM_METAIRQ_PRIORITIES=0
# CONFIG_SCHED_DEADLINE is not set
CONFIG_THREAD_STACK_INFO=y
# CONFIG_THREAD_CUSTOM_DATA is not set
# CONFIG_DYNAMIC_THREAD is not set
CONFIG_SCHED_DUMB=y
# CONFIG_SCHED_SCALABLE is not set
# CONFIG_SCHED_MULTIQ is not set
# CONFIG_WAITQ_SCALABLE is not set
CONFIG_WAITQ_DUMB=y

CONFIG_THREAD_NAME=y
CONFIG_THREAD_MAX_NAME_LEN=32

CONFIG_SYSTEM_WORKQUEUE_PRIORITY=-1

CONFIG_TIMESLICING=y
CONFIG_TIMESLICE_SIZE=0
CONFIG_TIMESLICE_PRIORITY=0
# CONFIG_TIMESLICE_PER_THREAD is not set

CONFIG_POLL=y
# CONFIG_MEM_SLAB_TRACE_MAX_UTILIZATION is not set
CONFIG_NUM_MBOX_ASYNC_MSGS=10
# CONFIG_EVENTS is not set
# CONFIG_PIPES is not set
CONFIG_KERNEL_MEM_POOL=y
# CONFIG_HEAP_MEM_POOL_IGNORE_MIN is not set
# end of Other Kernel Object Options
```

## src/main.c
```c
#include <zephyr/kernel.h>
#include <string.h>

struct k_mutex m;
struct k_timer t;

void threadA() {}

K_THREAD_DEFINE(thread_a, 1024, threadA, NULL, NULL, NULL,
		0, 0, 0);

K_MSGQ_DEFINE(q_name, 16, 16, 4);
char buffer[16*16];

struct k_work_delayable sampling_work;
static void soc_debug_sampling_work_handler(struct k_work *work) {}

int main() {
	k_mutex_init(&m);
    k_thread_join(thread_a, K_FOREVER);
	char x[5];
	strncpy(x, x, 4);
	k_timer_init(&t, NULL, NULL);
	k_msgq_init(&q_name, buffer, 16, 16);
	k_work_init_delayable(&sampling_work, soc_debug_sampling_work_handler);
	k_work_schedule(&sampling_work, K_MSEC(100));
	return 0;
}
```
